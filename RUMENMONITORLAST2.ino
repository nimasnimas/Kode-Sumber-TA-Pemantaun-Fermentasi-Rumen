/*============================================================
  RUMEN MONITOR — Arduino Nano
  Sensor aktif : DS18B20 (x1), DHT22, MH-Z14 (CO2),
                 Pressure (A0), TGS2611/CH4 (A1), pH DFRobot v1 (A2)

  Output CSV (8 field):
    temp1, dht_temp, dht_hum, co2, pt_adc, valve, tgs_adc

  OLED layout saat RUN (128×64):
    Full screen:
      Baris 1 : animasi roket (bitmaps) — ditampilkan di kiri
      Kanan   : "SYS RUNNING" + stopwatch HH:MM:SS
    Saat STOP : layar teks biasa
  ============================================================*/

#include <Wire.h>
#include <Adafruit_GFX.h>
#include <Adafruit_SSD1306.h>
#include <SoftwareSerial.h>
#include <OneWire.h>
#include <DallasTemperature.h>
#include <DHT.h>
#include <avr/wdt.h>
#include <avr/pgmspace.h>

/* ── PIN MAP ─────────────────────────────────────────────── */
#define PIN_BTN    4
#define PIN_RELAY  2
#define PIN_OW    11
#define PIN_DHT   12
#define PIN_PT    A0      // Pressure sensor
#define PIN_TGS   A1      // TGS2611 (CH4)
#define CO2_RX     8
#define CO2_TX     9

/* ── PERIHAL ─────────────────────────────────────────────── */
Adafruit_SSD1306 oled(128, 64, &Wire, -1);
OneWire           ow(PIN_OW);
DallasTemperature ds(&ow);
DHT               dht(PIN_DHT, DHT22);
SoftwareSerial    co2ser(CO2_RX, CO2_TX);

/* ── ANIMASI ROKET (64×64, disimpan di PROGMEM) ─────────── */
#define FRAME_W        64
#define FRAME_H        64
#define FRAME_DELAY_MS 42     // ~24 fps

const byte PROGMEM frames[][512] = {
  {0,0,0,0,0,0,0,0,0,0,0,0,0,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0,0},
  {0,0,0,0,0,0,0,0,0,0,0,0,0,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0,0},
  {0,0,0,0,0,0,0,0,0,0,0,0,0,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0,0},
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  {0,0,0,0,0,0,0,0,0,0,0,0,0,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0,0}
};

#define FRAME_COUNT  (sizeof(frames) / sizeof(frames[0]))

/* ── STATE ───────────────────────────────────────────────── */
enum { STOP, RUN };
byte     sysState  = STOP;
bool     btnPrev   = HIGH;
uint32_t btnPressT = 0;

/* ── DATA SENSOR ──────────────────────────────────────────── */
float    temp1    = 25.0f;
float    dhtT     = 25.0f, dhtH = 0.0f;
int      co2raw   = -1;
int      ptadc    = 0;
float    pressKpa = 0.0f;
int      tgsadc   = 0;
float    avgTgs   = 0.0f;

/* ── THRESHOLD RELAY ─────────────────────────────────────── */
#define PRESS_OPEN_KPA  5.0f
#define PRESS_CLOSE_KPA  3.9f

/* ── TIMERS ──────────────────────────────────────────────── */
uint32_t tSerial;
uint32_t tAnim  = 0;
uint32_t tOLED  = 0;

/* ── SEQUENTIAL SENSOR STATE ─────────────────────────────── */
#define SENSOR_INTERVAL_MS  8000UL   // 8 s between each sensor
#define SENSOR_STEP_COUNT   4        // DS18B20, DHT22, CO2, ADC

uint8_t  sensorStep = 0;            // current sensor in sequence
uint32_t tSensor    = 0;            // timestamp of last sensor read

/* ── ANIMASI & STOPWATCH state ───────────────────────────── */
uint8_t  animFrame  = 0;
uint32_t runStartMs = 0;

/* ── CO2 MH-Z14 ──────────────────────────────────────────── */
int readCO2() {
  static const byte cmd[9] = {0xFF, 0x01, 0x86, 0, 0, 0, 0, 0, 0x79};
  byte r[9];
  while (co2ser.available()) co2ser.read();
  co2ser.write(cmd, 9);
  uint32_t t = millis(); byte i = 0;
  while (millis() - t < 120 && i < 9)
    if (co2ser.available()) r[i++] = co2ser.read();
  if (i == 9 && r[0] == 0xFF && r[1] == 0x86)
    return r[2] * 256 + r[3];
  return -1;
}

/* ── Helper: format uint32 detik → "HH:MM:SS" ───────────── */
void fmtTime(uint32_t sec, char* buf) {
  uint16_t h = sec / 3600;
  uint8_t  m = (sec % 3600) / 60;
  uint8_t  s = sec % 60;
  buf[0] = '0' + (h / 10) % 10; buf[1] = '0' + h % 10;
  buf[2] = ':';
  buf[3] = '0' + m / 10;        buf[4] = '0' + m % 10;
  buf[5] = ':';
  buf[6] = '0' + s / 10;        buf[7] = '0' + s % 10;
  buf[8] = '\0';
}

/* ── OLED: layar STOP ────────────────────────────────────── */
void showStop() {
  oled.clearDisplay();
  oled.setTextSize(1);
  oled.setTextColor(SSD1306_WHITE);
  oled.setCursor(4, 0);
  oled.println(F("=== RUMEN MONITOR ==="));
  oled.println();
  oled.println(F("   STATUS : STOP"));
  oled.println();
  oled.println(F("  Tekan tombol mulai"));
  oled.display();
}

/* ── OLED: layar RUN ─────────────────────────────────────── */
void showRun() {
  oled.clearDisplay();
  oled.drawBitmap(0, 0, frames[animFrame],
                  FRAME_W, FRAME_H, SSD1306_WHITE);
  oled.setTextColor(SSD1306_WHITE);
  oled.setTextSize(1);
  oled.setCursor(66, 14);
  oled.print(F("SYS RUNNING"));
  oled.drawFastHLine(66, 28, 62, SSD1306_WHITE);
  char tbuf[9];
  fmtTime((millis() - runStartMs) / 1000UL, tbuf);
  oled.setCursor(66, 32);
  oled.print(tbuf);
  oled.drawFastHLine(66, 43, 62, SSD1306_WHITE);
  oled.display();
}

void broadcastState() {
  Serial.println(sysState == RUN ? F("STATUS:RUN") : F("STATUS:STOP"));
}
/* ── SETUP ───────────────────────────────────────────────── */
void setup() {
  wdt_enable(WDTO_8S); 
  Wire.begin();
  Serial.begin(9600);
  co2ser.begin(9600);
  dht.begin();
  ds.begin();
  pinMode(PIN_BTN,   INPUT_PULLUP);
  pinMode(PIN_RELAY, OUTPUT);
  digitalWrite(PIN_RELAY, HIGH);
  oled.begin(SSD1306_SWITCHCAPVCC, 0x3C);
  oled.setTextColor(SSD1306_WHITE);

  // ── Auto-RUN saat pertama nyala / restart ──
  sysState   = RUN;
  runStartMs = millis();
  animFrame  = 0;
  sensorStep = 0;
  tSensor    = millis();   // start first 8-s window immediately
  tSerial    = millis();
  showRun();
  broadcastState();
}


/* ── LOOP ────────────────────────────────────────────────── */
void loop() {
  wdt_reset();
  uint32_t now = millis();

  /* ─ Tombol: tekan pendek (<1.5 s) toggle RUN/STOP ─ */
  bool b = digitalRead(PIN_BTN);
  if (btnPrev && !b) btnPressT = now;
  if (!btnPrev && b) {
    if (now - btnPressT < 1500) {
      sysState = (sysState == STOP) ? RUN : STOP;
      if (sysState == RUN) {
        runStartMs = now;
        animFrame  = 0;
        sensorStep = 0;
        tSensor    = now;
      } else {
        digitalWrite(PIN_RELAY, HIGH);
      }
      broadcastState();
    }
  }
  btnPrev = b;

  /* ─ Sequential sensor polling — hanya saat RUN ─ */
  if (sysState == RUN && (now - tSensor >= SENSOR_INTERVAL_MS)) {
    tSensor = now;

    switch (sensorStep) {

      case 0:  /* ── DS18B20 ── */
        ds.requestTemperatures();
        {
          float t0 = ds.getTempCByIndex(0);
          if (t0 > -50 && t0 < 100) temp1 = t0;
        }
        break;

      case 1:  /* ── DHT22 ── */
        {
          float ht = dht.readTemperature();
          float hh = dht.readHumidity();
          if (!isnan(ht)) dhtT = ht;
          if (!isnan(hh)) dhtH = hh;
        }
        break;

      case 2:  /* ── CO2 MH-Z14 ── */
        {
          int v = readCO2();
          if (v > 0) co2raw = v;
        }
        break;

      case 3:  /* ── ADC: Pressure, TGS2611 ── */
        {
          long sumPT = 0, sumTGS = 0;
          for (int i = 0; i < 8; i++) {
            sumPT  += analogRead(PIN_PT);
            sumTGS += analogRead(PIN_TGS);
            delay(5);
          }
          // ptadc dihitung dulu dari rata-rata ADC
          ptadc  = (int)(sumPT / 8.0f);
          avgTgs = sumTGS / 8.0f;
          tgsadc = (int)avgTgs;
          
          const float PRESS_A = 255.1f;
          const float PRESS_B  = -143112.0f;
          pressKpa = (PRESS_A * ptadc + PRESS_B) / 1000.0f;

          if (pressKpa > PRESS_OPEN_KPA) {
              digitalWrite(PIN_RELAY, LOW);   // buka katup
          } else if (pressKpa < PRESS_CLOSE_KPA) {
              digitalWrite(PIN_RELAY, HIGH);  // tutup katup
          }
        }
        break;
    }

    /* advance to next sensor, wrap around */
    sensorStep = (sensorStep + 1) % SENSOR_STEP_COUNT;
  }

  /* ─ Serial output per 1 menit
     FORMAT: temp1,dht_temp,dht_hum,co2,pt_adc,valve,tgs_adc, */
  if (sysState == RUN && (now - tSerial > 60000UL)) {
    tSerial = now;
    Serial.print(temp1);   Serial.print(',');
    Serial.print(dhtT);    Serial.print(',');
    Serial.print(dhtH);    Serial.print(',');
    Serial.print(co2raw);  Serial.print(',');
    Serial.print(ptadc);   Serial.print(',');
    Serial.print(digitalRead(PIN_RELAY) == LOW ? 1 : 0); Serial.print(',');
    Serial.println(tgsadc);  
  }

  /* ─ Advance animasi ─ */
  if (sysState == RUN && now - tAnim >= FRAME_DELAY_MS) {
    tAnim     = now;
    animFrame = (animFrame + 1) % FRAME_COUNT;
  }

  /* ─ OLED refresh 10 fps ─ */
  if (now - tOLED >= 100) {
    tOLED = now;
    (sysState == RUN) ? showRun() : showStop();
  }
}